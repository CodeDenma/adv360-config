## config/boards/arm/adv360/Kconfig
```kconfig
# SPDX-License-Identifier: MIT

config BOARD_ENABLE_DCDC
	bool "Enable DCDC mode"
	select SOC_DCDC_NRF52X
	default y
	depends on BOARD_ADV360_LEFT || BOARD_ADV360_RIGHT

CONFIG_ZMK_MACRO_DEFAULT_WAIT_MS=30
```
